## config/boards/shields/zmk100/Kconfig.defconfig
```kconfig
if SHIELD_zmk100_LEFT

# Name must be less than 16 characters long!
config ZMK_KEYBOARD_NAME
    default "zmk100"

config ZMK_SPLIT_ROLE_CENTRAL
    default y

endif

if SHIELD_zmk100_LEFT || SHIELD_zmk100_RIGHT

config ZMK_SPLIT
    default y

endif
```

## config/boards/shields/zmk100/Kconfig.shield
```kconfig
config SHIELD_zmk100_LEFT
    def_bool $(shields_list_contains,zmk100_left)

config SHIELD_zmk100_RIGHT
    def_bool $(shields_list_contains,zmk100_right)
```
